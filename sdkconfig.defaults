## sdkconfig.defaults
```kconfig
# Rust often needs a bit of an extra main task stack size compared to C (the default is 3K)
CONFIG_ESP_MAIN_TASK_STACK_SIZE=7000

# Use this to set FreeRTOS kernel tick frequency to 1000 Hz (100 Hz by default).
# This allows to use 1 ms granuality for thread sleeps (10 ms by default).
#CONFIG_FREERTOS_HZ=1000

# Enable the option to dispatch timer events directly from the timer ISR 
# (the executor & async timer wrapper of `esp-idf-svc` are compatible with this dispatch method)
# This has lower latency as compared to dispatcching via an intermediate task
CONFIG_ESP_TIMER_SUPPORTS_ISR_DISPATCH_METHOD=y

# Enable posting to event loops directly from an ISR 
# (the event loop wrapper of `esp-idf-svc` is compatible with this, including the async postbox wrapper)
CONFIG_ESP_EVENT_POST_FROM_ISR=y

# CONFIG_LOG_DEFAULT_LEVEL_VERBOSE=y
CONFIG_ESP_TIMER_INTERRUPT_LEVEL=2
#CONFIG_ESP_TIMER_IMPL_FRC2=y
```
